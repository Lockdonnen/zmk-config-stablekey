/*
 * Copyright (c) 2020 Ryan Cross, Bruce Jones
 *
 * SPDX-License-Identifier: MIT
 */

#include "dactyl-stabilized.dtsi"

&kscan0 {
	col-gpios
		= <&pro_micro_a 10 GPIO_ACTIVE_HIGH>
		, <&pro_micro_a 16 GPIO_ACTIVE_HIGH>
		, <&pro_micro_a 14 GPIO_ACTIVE_HIGH>
		, <&pro_micro_d 15 GPIO_ACTIVE_HIGH>
		, <&pro_micro_d 0 GPIO_ACTIVE_HIGH>
		, <&pro_micro_d 1 GPIO_ACTIVE_HIGH>
		, <&pro_micro_d 2 GPIO_ACTIVE_HIGH>
		;
};
